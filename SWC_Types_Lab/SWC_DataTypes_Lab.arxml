AUTOSAR XML (schema 00046)
standard types defined: uint8
package /MyDataPackage
  physical dimension distance_in_meters: length-exp=1
  unit meters: factor-si-to-unit=1, physical-dimension=distance_in_meters
  compu method cm_meters: identical; unit meters
  app type MyMetersTypes: category=VALUE, compu-method=cm_meters
  application array data type MyMetersArrayType: category=ARRAY
    element element: category=VALUE, type=MyMetersType, array-size-semantics=FIXED-SIZE, max-number-of-elements=4
  application record data type MyPointType: category=STRUCTURE
    application record element X: category=VALUE, type=MyMetersType
    application record element Y: category=VALUE, type=MyMetersType
  base type my_sint8: base-type-size=8, base-type-encoding=2C, mem-alignment=1, native-declaration=char
  base type my_uint8: base-type-size=8, base-type-encoding=NONE, mem-alignment=1, native-declaration=unsigned char
  range dc_uint8: phys 0..255, raw 0..255
  data type mapping set DATA_TYPE_Mapping: data-type-map{application-data-type=MyMetersTypes, implementation-data-type=uint8}
