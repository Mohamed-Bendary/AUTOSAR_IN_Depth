AUTOSAR XML (schema 00046)
package /CS_Interface_Lab
  client server interface CSI_1
    operation OP_SUM
      arg Operator_1: type=uint16, direction=IN
      arg Operator_2: type=uint16, direction=IN
      arg Operator_1: type=uint32, direction=IN
  application sw component type SWC1_Server_CSI_SUM
    provide port PP_CSI_SUM: client-server-annotation=OP_SUM
  application sw component type SWC2_Client_CSI_SUM
    require port RP_CSI_SUM: client-server-annotation=OP_SUM
