AUTOSAR XML (schema 00046)
package /Interface_SRI_PRPorts
  sender receiver interface SRI_1
    data Lidar_ObjectDistance: type=uint16, init-value=0
    data Lidar_ObjectID: type=uint16, init-value=0
    data Lidar_ObjectAngle: type=uint16, init-value=0
  application sw component type APP_SWC1
    require port Lidar_Rport: required-interface=SRI_1
  sensor actuator sw component type Lidar_SWC1
    provide port Lidar_Sport: provided-interface=SRI_1
