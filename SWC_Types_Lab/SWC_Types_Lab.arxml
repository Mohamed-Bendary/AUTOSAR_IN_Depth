AUTOSAR XML (schema 00046)
package /SWCs_EARBS_Package
  sensor actuator sw component type Lidar_SWC1
  sensor actuator sw component type SpeedSensor_SWC2
  ecu abstraction sw component type IOAbstraction_SWC3
  application sw component type EABS_SWC4
  parameter sw component type Parameters_SWC5
  sensor actuator sw component type LED_Warning_SWC6
  complex device driver sw component type Brakes_CDD_SWC7
  service sw component type DIgManger_SWC8
  nv block sw component type Flash_NVBLCK_SWC9
