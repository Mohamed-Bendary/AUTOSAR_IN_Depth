AUTOSAR XML (schema 00046)
package /Interfaces_Lab
  sender receiver interface SRI_1
    data Variable_1: sw-impl-policy=QUEUED, type=uint32, init-value=12
    data Variable_2
  application sw component type SWC1
    provide port Pport1: provided-interface=SRI_1
