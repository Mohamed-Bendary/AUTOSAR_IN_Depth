AUTOSAR XML (schema 00046)
package /INTERFACES
  sender receiver interface IF_SR_LIDARData
    data LIDARSENSOR: type=uint32
